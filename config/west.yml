## config/west.yml
```yaml
manifest:
  remotes:
    - name: zmkfirmware
      url-base: https://github.com/zmkfirmware
    # dongle_display
    - name: englmaxi
      url-base: https://github.com/englmaxi
    # nice_oled - nice_epaper - dongle_display!view - oled Adapter
    - name: mctechnology17
      url-base: https://github.com/mctechnology17
    - name: prospector
      url-base: https://github.com/t-ogura
  projects:
    - name: zmk
      remote: zmkfirmware
      revision: main
      import: app/west.yml
    # dongle_display
    - name: zmk-dongle-display
      remote: englmaxi
      revision: main
    # nice_oled - nice_epaper
    - name: zmk-nice-oled
      remote: mctechnology17
      revision: main
    # dongle_display!view
    - name: zmk-dongle-display-view
      remote: mctechnology17
      revision: main
    # oled Adapter
    - name: zmk-oled-adapter
      remote: mctechnology17
      revision: main
    - name: prospector-zmk-module
      remote: prospector
      revision: v1.1.1
      path: modules/prospector-zmk-module
  self:
    path: config
```
